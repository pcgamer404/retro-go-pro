/* Generated by scripts/neogeo_modern_sets.py from current MAME's neogeo.cpp: do not edit. */
GAME( 1990, nam1975m, nam1975, neogeo, neogeo, neogeo, ROT0, "SNK", "NAM-1975 (NGM-001 ~ NGH-001) (modern set)" )
GAME( 1990, bstarsm, bstars, neogeo, neogeo, neogeo, ROT0, "SNK", "Baseball Stars Professional (NGM-002) (modern set)" )
GAME( 1990, tpgolfm, tpgolf, neogeo, neogeo, neogeo, ROT0, "SNK", "Top Player's Golf (NGM-003 ~ NGH-003) (modern set)" )
GAME( 1990, mahretsum, mahretsu, neogeo, neogeo, neogeo, ROT0, "SNK", "Mahjong Kyo Retsuden (NGM-004 ~ NGH-004) (modern set)" )
GAME( 1990, maglordm, maglord, neogeo, neogeo, neogeo, ROT0, "Alpha Denshi Co.", "Magician Lord (NGM-005) (modern set)" )
GAME( 1991, alpham2m, alpham2, neogeo, neogeo, neogeo, ROT0, "SNK", "Alpha Mission II / ASO II - Last Guardian (NGM-007 ~ NGH-007) (modern set)" )
GAME( 1990, ncombatm, ncombat, neogeo, neogeo, neogeo, ROT0, "Alpha Denshi Co.", "Ninja Combat (NGM-009) (modern set)" )
GAME( 1990, cyberlipm, cyberlip, neogeo, neogeo, neogeo, ROT0, "SNK", "Cyber-Lip (NGM-010) (modern set)" )
GAME( 1990, superspym, superspy, neogeo, neogeo, neogeo, ROT0, "SNK", "The Super Spy (NGM-011 ~ NGH-011) (modern set)" )
GAME( 1992, mutnatm, mutnat, neogeo, neogeo, neogeo, ROT0, "SNK", "Mutation Nation (NGM-014 ~ NGH-014) (modern set)" )
GAME( 1991, kotmm, kotm, neogeo, neogeo, neogeo, ROT0_16BIT, "SNK", "King of the Monsters (set 1) (modern set)" )
GAME( 1991, sengokum, sengoku, neogeo, neogeo, neogeo, ROT0, "SNK", "Sengoku / Sengoku Denshou (NGM-017 ~ NGH-017) (modern set)" )
GAME( 1991, burningfm, burningf, neogeo, neogeo, neogeo, ROT0, "SNK", "Burning Fight (NGM-018 ~ NGH-018) (modern set)" )
GAME( 1990, lbowlingm, lbowling, neogeo, neogeo, neogeo, ROT0, "SNK", "League Bowling (NGM-019 ~ NGH-019) (modern set)" )
GAME( 1991, gpilotsm, gpilots, neogeo, neogeo, neogeo, ROT0, "SNK", "Ghost Pilots (NGM-020 ~ NGH-020) (modern set)" )
GAME( 1990, joyjoym, joyjoy, neogeo, neogeo, neogeo, ROT0, "SNK", "Puzzled / Joy Joy Kid (NGM-021 ~ NGH-021) (modern set)" )
GAME( 1990, bjourneym, bjourney, neogeo, neogeo, neogeo, ROT0, "Alpha Denshi Co.", "Blue's Journey / Raguy (ALM-001 ~ ALH-001) (modern set)" )
GAME( 1991, quizdaism, quizdais, neogeo, neogeo, neogeo, ROT0, "SNK", "Quiz Daisousa Sen - The Last Count Down (NGM-023 ~ NGH-023) (modern set)" )
GAME( 1992, lresortm, lresort, neogeo, neogeo, neogeo, ROT0_16BIT, "SNK", "Last Resort (modern set)" )
GAME( 1991, eightmanm, eightman, neogeo, neogeo, neogeo, ROT0, "SNK / Pallas", "Eight Man (NGM-025 ~ NGH-025) (modern set)" )
GAME( 1991, legendosm, legendos, neogeo, neogeo, neogeo, ROT0, "SNK / Wave", "Legend of Success Joe / Ashita no Joe Densetsu (modern set)" )
GAME( 1991, 2020bbm, 2020bb, neogeo, neogeo, neogeo, ROT0, "SNK / Pallas", "2020 Super Baseball (set 1) (modern set)" )
GAME( 1991, socbrawlm, socbrawl, neogeo, neogeo, neogeo, ROT0, "SNK", "Soccer Brawl (NGM-031) (modern set)" )
GAME( 1991, roboarmym, roboarmy, neogeo, neogeo, neogeo, ROT0, "SNK", "Robo Army (modern set)" )
GAME( 1991, fatfury1m, fatfury1, neogeo, neogeo, neogeo, ROT0, "SNK", "Fatal Fury - King of Fighters / Garou Densetsu - Shukumei no Tatakai (NGM-033 ~ NGH-033) (modern set)" )
GAME( 1992, fbfrenzym, fbfrenzy, neogeo, neogeo, neogeo, ROT0, "SNK", "Football Frenzy (NGM-034 ~ NGH-034) (modern set)" )
GAME( 1991, crswordm, crsword, neogeo, neogeo, neogeo, ROT0, "Alpha Denshi Co.", "Crossed Swords (ALM-002 ~ ALH-002) (modern set)" )
GAME( 1991, trallym, trally, neogeo, neogeo, neogeo, ROT0, "Alpha Denshi Co.", "Thrash Rally (ALM-003 ~ ALH-003) (modern set)" )
GAME( 1992, bstars2m, bstars2, neogeo, neogeo, neogeo, ROT0, "SNK", "Baseball Stars 2 (modern set)" )
GAME( 1992, quizdai2m, quizdai2, neogeo, neogeo, neogeo, ROT0, "SNK", "Quiz Meitantei Neo & Geo - Quiz Daisousa Sen part 2 (NGM-042 ~ NGH-042) (modern set)" )
GAME( 1993, samshom, samsho, neogeo, neogeo, neogeo, ROT0_16BIT, "SNK", "Samurai Shodown / Samurai Spirits (NGM-045) (modern set)" )
GAME( 1994, tophuntrm, tophuntr, neogeo, neogeo, neogeo, ROT0_16BIT, "SNK", "Top Hunter - Roddy & Cathy (NGM-046) (modern set)" )
GAME( 1992, androdunm, androdun, neogeo, neogeo, neogeo, ROT0, "Visco", "Andro Dunos (NGM-049 ~ NGH-049) (modern set)" )
GAME( 1992, ncommandm, ncommand, neogeo, neogeo, neogeo, ROT0, "Alpha Denshi Co.", "Ninja Commando (modern set)" )
GAME( 1994, kof94m, kof94, neogeo, neogeo, neogeo, ROT0_16BIT, "SNK", "The King of Fighters '94 (NGM-055 ~ NGH-055) (modern set)" )
GAME( 1994, aof2m, aof2, neogeo, neogeo, neogeo, ROT0_16BIT, "SNK", "Art of Fighting 2 / Ryuuko no Ken 2 (NGM-056) (modern set)" )
GAME( 1993, wh2m, wh2, neogeo, neogeo, neogeo, ROT0, "ADK", "World Heroes 2 (ALM-006 ~ ALH-006) (modern set)" )
GAME( 1993, fatfurspm, fatfursp, neogeo, neogeo, neogeo, ROT0, "SNK", "Fatal Fury Special / Garou Densetsu Special (NGM-058 ~ NGH-058, set 1) (modern set)" )
GAME( 1995, savagerem, savagere, neogeo, neogeo, neogeo, ROT0_16BIT, "SNK", "Savage Reign / Fu'un Mokushiroku - Kakutou Sousei (modern set)" )
GAME( 1994, fightfevm, fightfev, neogeo, neogeo, neogeo, ROT0, "Viccom", "Fight Fever / Wang Jung Wang (set 1) (modern set)" )
GAME( 1994, ssideki2m, ssideki2, neogeo, neogeo, neogeo, ROT0_16BIT, "SNK", "Super Sidekicks 2 - The World Championship / Tokuten Ou 2 - Real Fight Football (NGM-061 ~ NGH-061) (modern set)" )
GAME( 1993, spinmastm, spinmast, neogeo, neogeo, neogeo, ROT0_16BIT, "Data East Corporation", "Spin Master / Miracle Adventure (modern set)" )
GAME( 1994, samsho2m, samsho2, neogeo, neogeo, neogeo, ROT0_16BIT, "SNK", "Samurai Shodown II / Shin Samurai Spirits - Haohmaru Jigokuhen (NGM-063 ~ NGH-063) (modern set)" )
GAME( 1994, wh2jm, wh2j, neogeo, neogeo, neogeo, ROT0, "ADK / SNK", "World Heroes 2 Jet (ADM-007 ~ ADH-007) (modern set)" )
GAME( 1994, wjammersm, wjammers, neogeo, neogeo, neogeo, ROT0, "Data East Corporation", "Windjammers / Flying Power Disc (modern set)" )
GAME( 1994, karnovrm, karnovr, neogeo, neogeo, neogeo, ROT0_16BIT, "Data East Corporation", "Karnov's Revenge / Fighter's History Dynamite (modern set)" )
GAME( 1994, gururinm, gururin, neogeo, neogeo, neogeo, ROT0, "Face", "Gururin (modern set)" )
GAME( 1994, pspikes2m, pspikes2, neogeo, neogeo, neogeo, ROT0, "Video System Co.", "Power Spikes II (NGM-068) (modern set)" )
GAME( 1995, fatfury3m, fatfury3, neogeo, neogeo, neogeo, ROT0_16BIT, "SNK", "Fatal Fury 3 - Road to the Final Victory / Garou Densetsu 3 - Haruka-naru Tatakai (NGM-069 ~ NGH-069) (modern set)" )
GAME( 2000, b2b, neogeo, neogeo, neogeo, neogeo, ROT0, "Visco", "Bang Bang Busters (2010 NCI release) (modern set)" )
GAME( 1994, panicbomm, panicbom, neogeo, neogeo, neogeo, ROT0, "Eighting / Hudson Soft", "Panic Bomber (modern set)" )
GAME( 1994, aodkm, aodk, neogeo, neogeo, neogeo, ROT0, "ADK / SNK", "Aggressors of Dark Kombat / Tsuukai GANGAN Koushinkyoku (ADM-008 ~ ADH-008) (modern set)" )
GAME( 1994, sonicwi2m, sonicwi2, neogeo, neogeo, neogeo, ROT0, "Video System Co.", "Aero Fighters 2 / Sonic Wings 2 (modern set)" )
GAME( 1994, zedbladem, zedblade, neogeo, neogeo, neogeo, ROT0_16BIT, "NMK", "Zed Blade / Operation Ragnarok (modern set)" )
GAME( 1995, galaxyfgm, galaxyfg, neogeo, neogeo, neogeo, ROT0_16BIT, "Sunsoft", "Galaxy Fight - Universal Warriors (modern set)" )
GAME( 1994, strhoopm, strhoop, neogeo, neogeo, neogeo, ROT0, "Data East Corporation", "Street Hoop / Street Slam / Dunk Dream (DEM-004 ~ DEH-004) (modern set)" )
GAME( 1995, quizkofm, quizkof, neogeo, neogeo, neogeo, ROT0, "Saurus (SNK license)", "Quiz King of Fighters (SAM-080 ~ SAH-080) (modern set)" )
GAME( 1995, ssideki3m, ssideki3, neogeo, neogeo, neogeo, ROT0_16BIT, "SNK", "Super Sidekicks 3 - The Next Glory / Tokuten Ou 3 - Eikou e no Chousen (modern set)" )
GAME( 1995, doubledrm, doubledr, neogeo, neogeo, neogeo, ROT0, "Technos Japan", "Double Dragon (Neo-Geo) (modern set)" )
GAME( 1995, kof95m, kof95, neogeo, neogeo, neogeo, ROT0_16BIT, "SNK", "The King of Fighters '95 (NGM-084) (modern set)" )
GAME( 1996, twsoc96, neogeo, neogeo, neogeo, neogeo, ROT0, "Tecmo", "Tecmo World Soccer '96 (modern set)" )
GAME( 1995, samsho3m, samsho3, neogeo, neogeo, neogeo, ROT0_16BIT, "SNK", "Samurai Shodown III / Samurai Spirits - Zankurou Musouken (NGM-087) (modern set)" )
GAME( 1995, stakwinm, stakwin, neogeo, neogeo, neogeo, ROT0, "Saurus", "Stakes Winner / Stakes Winner - GI Kinzen Seiha e no Michi (modern set)" )
GAME( 1995, pulstarm, pulstar, neogeo, neogeo, neogeo, ROT0_16BIT, "Aicom", "Pulstar (modern set)" )
GAME( 1995, whpm, whp, neogeo, neogeo, neogeo, ROT0_16BIT, "ADK / SNK", "World Heroes Perfect (modern set)" )
GAME( 1995, kabukiklm, kabukikl, neogeo, neogeo, neogeo, ROT0_16BIT, "Hudson Soft", "Far East of Eden - Kabuki Klash / Tengai Makyou - Shin Den (modern set)" )
GAME( 1997, neobombem, neobombe, neogeo, neogeo, neogeo, ROT0, "Hudson Soft", "Neo Bomberman (modern set)" )
GAME( 1995, gowcaizrm, gowcaizr, neogeo, neogeo, neogeo, ROT0_16BIT, "Technos Japan", "Voltage Fighter - Gowcaizer / Choujin Gakuen Gowcaizer (modern set)" )
GAME( 1995, rbff1m, rbff1, neogeo, neogeo, neogeo, ROT0_16BIT, "SNK", "Real Bout Fatal Fury / Real Bout Garou Densetsu (NGM-095 ~ NGH-095) (modern set)" )
GAME( 1996, aof3m, aof3, neogeo, neogeo, neogeo, ROT0_16BIT, "SNK", "Art of Fighting 3 - The Path of the Warrior / Art of Fighting - Ryuuko no Ken Gaiden (modern set)" )
GAME( 1995, sonicwi3m, sonicwi3, neogeo, neogeo, neogeo, ROT0, "Video System Co.", "Aero Fighters 3 / Sonic Wings 3 (modern set)" )
GAME( 1996, turfmastm, turfmast, neogeo, neogeo, neogeo, ROT0_16BIT, "Nazca", "Neo Turf Masters / Big Tournament Golf (modern set)" )
GAME( 1996, mslugm, mslug, neogeo, neogeo, neogeo, ROT0, "Nazca", "Metal Slug - Super Vehicle-001 (modern set)" )
GAME( 1995, puzzledpm, puzzledp, neogeo, neogeo, neogeo, ROT0, "Visco", "Puzzle De Pon! (modern set)" )
GAME( 1995, moshougi, neogeo, neogeo, neogeo, neogeo, ROT0, "ADK / SNK", "Shougi no Tatsujin - Master of Shougi (modern set)" )
GAME( 1995, marukodqm, marukodq, neogeo, neogeo, neogeo, ROT0, "Takara", "Chibi Maruko-chan: Maruko Deluxe Quiz (modern set)" )
GAME( 1996, neomrdom, neomrdo, neogeo, neogeo, neogeo, ROT0, "Visco", "Neo Mr. Do! (modern set)" )
GAME( 1996, sdodgebm, sdodgeb, neogeo, neogeo, neogeo, ROT0_16BIT, "Technos Japan", "Super Dodge Ball / Kunio no Nekketsu Toukyuu Densetsu (modern set)" )
GAME( 1995, goalx3m, goalx3, neogeo, neogeo, neogeo, ROT0, "Visco", "Goal! Goal! Goal! (modern set)" )
GAME( 1996, overtopm, overtop, neogeo, neogeo, neogeo, ROT0_16BIT, "ADK", "Over Top (modern set)" )
GAME( 1996, neodriftm, neodrift, neogeo, neogeo, neogeo, ROT0, "Visco", "Neo Drift Out - New Technology (modern set)" )
GAME( 1996, kof96m, kof96, neogeo, neogeo, neogeo, ROT0_16BIT, "SNK", "The King of Fighters '96 (NGM-214) (modern set)" )
GAME( 1996, ssideki4m, ssideki4, neogeo, neogeo, neogeo, ROT0_16BIT, "SNK", "The Ultimate 11 - The SNK Football Championship / Tokuten Ou - Honoo no Libero (modern set)" )
GAME( 1996, kizunam, kizuna, neogeo, neogeo, neogeo, ROT0_16BIT, "SNK", "Kizuna Encounter - Super Tag Battle / Fu'un Super Tag Battle (modern set)" )
GAME( 1996, ninjamasm, ninjamas, neogeo, neogeo, neogeo, ROT0, "ADK / SNK", "Ninja Master's - Haoh-ninpo-cho (modern set)" )
GAME( 1996, ragnagrdm, ragnagrd, neogeo, neogeo, neogeo, ROT0_16BIT, "Saurus", "Ragnagard / Shin-Oh-Ken (modern set)" )
GAME( 1996, pgoalm, pgoal, neogeo, neogeo, neogeo, ROT0, "Saurus", "Pleasure Goal / Futsal - 5 on 5 Mini Soccer (NGM-219) (modern set)" )
GAME( 1996, ironclad, neogeo, neogeo, neogeo, neogeo, ROT0, "Saurus", "Choutetsu Brikin'ger / Iron Clad (prototype) (modern set)" )
GAME( 1996, magdrop2m, magdrop2, neogeo, neogeo, neogeo, ROT0, "Data East Corporation", "Magical Drop II (modern set)" )
GAME( 1996, samsho4m, samsho4, neogeo, neogeo, neogeo, ROT0_16BIT, "SNK", "Samurai Shodown IV - Amakusa's Revenge / Samurai Spirits - Amakusa Kourin (NGM-222 ~ NGH-222) (modern set)" )
GAME( 1996, rbffspecm, rbffspec, neogeo, neogeo, neogeo, ROT0_16BIT, "SNK", "Real Bout Fatal Fury Special / Real Bout Garou Densetsu Special (modern set)" )
GAME( 1996, twinsprim, twinspri, neogeo, neogeo, neogeo, ROT0_16BIT, "ADK / SNK", "Twinkle Star Sprites (modern set)" )
GAME( 1996, wakuwak7m, wakuwak7, neogeo, neogeo, neogeo, ROT0_16BIT, "Sunsoft", "Waku Waku 7 (modern set)" )
GAME( 1996, stakwin2m, stakwin2, neogeo, neogeo, neogeo, ROT0, "Saurus", "Stakes Winner 2 (modern set)" )
GAME( 1996, ghostlop, neogeo, neogeo, neogeo, neogeo, ROT0, "Data East Corporation", "Ghostlop (prototype) (modern set)" )
GAME( 1996, breakersm, breakers, neogeo, neogeo, neogeo, ROT0_16BIT, "Visco", "Breakers (modern set)" )
GAME( 1997, miexchngm, miexchng, neogeo, neogeo, neogeo, ROT0_16BIT, "Face", "Money Puzzle Exchanger / Money Idol Exchanger (modern set)" )
GAME( 1997, kof97m, kof97, neogeo, neogeo, neogeo, ROT0_16BIT, "SNK", "The King of Fighters '97 (NGM-2320) (modern set)" )
GAME( 1997, magdrop3m, magdrop3, neogeo, neogeo, neogeo, ROT0, "Data East Corporation", "Magical Drop III (modern set)" )
GAME( 1997, lastbladm, lastblad, neogeo, neogeo, neogeo, ROT0_16BIT, "SNK", "The Last Blade / Bakumatsu Roman - Gekka no Kenshi (NGM-2340) (modern set)" )
GAME( 1997, puzzldprm, puzzldpr, neogeo, neogeo, neogeo, ROT0, "Visco", "Puzzle De Pon! R! (modern set)" )
GAME( 1997, popbouncm, popbounc, neogeo, neogeo, neogeo, ROT0_16BIT, "Video System Co.", "Pop 'n Bounce / Gapporin (modern set)" )
GAME( 1997, shocktrom, shocktro, neogeo, neogeo, neogeo, ROT0_16BIT, "Saurus", "Shock Troopers (set 1) (modern set)" )
GAME( 1998, blazstarm, blazstar, neogeo, neogeo, neogeo, ROT0_16BIT, "Yumekobo", "Blazing Star (modern set)" )
GAME( 1998, rbff2m, rbff2, neogeo, neogeo, neogeo, ROT0_16BIT, "SNK", "Real Bout Fatal Fury 2 - The Newcomers / Real Bout Garou Densetsu 2 - The Newcomers (NGM-2400) (modern set)" )
GAME( 1998, mslug2m, mslug2, neogeo, neogeo, neogeo, ROT0_16BIT, "SNK", "Metal Slug 2 - Super Vehicle-001/II (NGM-2410 ~ NGH-2410) (modern set)" )
GAME( 1998, lastbld2m, lastbld2, neogeo, neogeo, neogeo, ROT0_16BIT, "SNK", "The Last Blade 2 / Bakumatsu Roman - Dai Ni Maku Gekka no Kenshi (NGM-2430 ~ NGH-2430) (modern set)" )
GAME( 1998, neocup98m, neocup98, neogeo, neogeo, neogeo, ROT0_16BIT, "SNK", "Neo-Geo Cup '98 - The Road to the Victory (modern set)" )
GAME( 1998, breakrevm, breakrev, neogeo, neogeo, neogeo, ROT0_16BIT, "Visco", "Breakers Revenge (modern set)" )
GAME( 1998, shocktr2m, shocktr2, neogeo, neogeo, neogeo, ROT0_16BIT, "Saurus", "Shock Troopers - 2nd Squad (modern set)" )
GAME( 1998, flipshotm, flipshot, neogeo, neogeo, neogeo, ROT0, "Visco", "Flip Shot (modern set)" )
GAME( 1999, pbobbl2nm, pbobbl2n, neogeo, neogeo, neogeo, ROT0, "Taito (SNK license)", "Puzzle Bobble 2 / Bust-A-Move Again (Neo-Geo) (modern set)" )
GAME( 1999, ctomadaym, ctomaday, neogeo, neogeo, neogeo, ROT0, "Visco", "Captain Tomaday (modern set)" )
GAME( 1999, mslugxm, mslugx, neogeo, neogeo, neogeo, ROT0_16BIT, "SNK", "Metal Slug X - Super Vehicle-001 (NGM-2500 ~ NGH-2500) (modern set)" )
GAME( 2001, vliner, neogeo, neogeo, neogeo, neogeo, ROT0, "Dyna / BrezzaSoft", "V-Liner (v0.7a) (modern set)" )
GAME( 1996, zintrckb, neogeo, neogeo, neogeo, neogeo, ROT0, "bootleg", "Zintrick / Oshidashi Zentrix (bootleg of CD version) (modern set)" )
GAME( 1995, froman2b, neogeo, neogeo, neogeo, neogeo, ROT0, "bootleg", "Idol Mahjong Final Romance 2 (Neo-Geo, bootleg of CD version) (modern set)" )
GAME( 1996, crswd2bl, neogeo, neogeo, neogeo, neogeo, ROT0, "bootleg (Razoola)", "Crossed Swords 2 (bootleg of CD version) (modern set)" )
GAME( 2000, diggerma, neogeo, neogeo, neogeo, neogeo, ROT0, "Kyle Hodgetts", "Digger Man (prototype) (modern set)" )
GAME( 2005, lasthope, neogeo, neogeo, neogeo, neogeo, ROT0, "NG:DEV.TEAM", "Last Hope (bootleg AES to MVS conversion, no coin support) (modern set)" )
GAME( 1990, bstarsh, bstarsm, neogeo, neogeo, neogeo, ROT0, "SNK", "Baseball Stars Professional (NGH-002) (modern set)" )
GAME( 1990, maglordhm, maglordm, neogeo, neogeo, neogeo, ROT0, "Alpha Denshi Co.", "Magician Lord (NGH-005) (modern set)" )
GAME( 1990, ncombath, ncombatm, neogeo, neogeo, neogeo, ROT0, "Alpha Denshi Co.", "Ninja Combat (NGH-009) (modern set)" )
GAME( 1991, kotmh, kotmm, neogeo, neogeo, neogeo, ROT0_16BIT, "SNK", "King of the Monsters (set 2) (modern set)" )
GAME( 1991, sengokuh, sengokum, neogeo, neogeo, neogeo, ROT0, "SNK", "Sengoku / Sengoku Denshou (NGH-017, US) (modern set)" )
GAME( 1991, burningfh, burningfm, neogeo, neogeo, neogeo, ROT0, "SNK", "Burning Fight (NGH-018, US) (modern set)" )
GAME( 1991, gpilotsh, gpilotsm, neogeo, neogeo, neogeo, ROT0, "SNK", "Ghost Pilots (NGH-020, US) (modern set)" )
GAME( 1990, bjourneyh, bjourneym, neogeo, neogeo, neogeo, ROT0, "Alpha Denshi Co.", "Blue's Journey / Raguy (ALH-001) (modern set)" )
GAME( 1995, quizdaisk, quizdaism, neogeo, neogeo, neogeo, ROT0, "SNK / Viccom", "Quiz Salibtamjeong - The Last Count Down (Korean localized Quiz Daisousa Sen) (modern set)" )
GAME( 1991, 2020bba, 2020bbm, neogeo, neogeo, neogeo, ROT0, "SNK / Pallas", "2020 Super Baseball (set 2) (modern set)" )
GAME( 1991, socbrawlh, socbrawlm, neogeo, neogeo, neogeo, ROT0, "SNK", "Soccer Brawl (NGH-031) (modern set)" )
GAME( 1993, samshoh, samshom, neogeo, neogeo, neogeo, ROT0_16BIT, "SNK", "Samurai Shodown / Samurai Spirits (NGH-045) (modern set)" )
GAME( 1994, tophuntrh, tophuntrm, neogeo, neogeo, neogeo, ROT0_16BIT, "SNK", "Top Hunter - Roddy & Cathy (NGH-046) (modern set)" )
GAME( 1994, aof2a, aof2m, neogeo, neogeo, neogeo, ROT0_16BIT, "SNK", "Art of Fighting 2 / Ryuuko no Ken 2 (NGH-056) (modern set)" )
GAME( 1993, wh2h, wh2m, neogeo, neogeo, neogeo, ROT0, "ADK", "World Heroes 2 (ALH-006) (modern set)" )
GAME( 1993, fatfurspa, fatfurspm, neogeo, neogeo, neogeo, ROT0, "SNK", "Fatal Fury Special / Garou Densetsu Special (NGM-058 ~ NGH-058, set 2) (modern set)" )
GAME( 1994, fightfeva, fightfevm, neogeo, neogeo, neogeo, ROT0, "Viccom", "Fight Fever / Wang Jung Wang (set 2) (modern set)" )
GAME( 1994, samsho2k, samsho2m, neogeo, neogeo, neogeo, ROT0_16BIT, "SNK", "Saulabi Spirits / Jin Saulabi Tu Hon (Korean release of Samurai Shodown II, set 1) (modern set)" )
GAME( 1994, samsho2ka, samsho2m, neogeo, neogeo, neogeo, ROT0_16BIT, "SNK", "Saulabi Spirits / Jin Saulabi Tu Hon (Korean release of Samurai Shodown II, set 2) (modern set)" )
GAME( 1996, quizkofk, quizkofm, neogeo, neogeo, neogeo, ROT0, "Saurus / Viccom (SNK license)", "Quiz King of Fighters (Korea) (modern set)" )
GAME( 1995, kof95a, kof95m, neogeo, neogeo, neogeo, ROT0_16BIT, "SNK", "The King of Fighters '95 (NGM-084, alt board) (modern set)" )
GAME( 1995, kof95h, kof95m, neogeo, neogeo, neogeo, ROT0_16BIT, "SNK", "The King of Fighters '95 (NGH-084) (modern set)" )
GAME( 1995, samsho3h, samsho3m, neogeo, neogeo, neogeo, ROT0_16BIT, "SNK", "Samurai Shodown III / Samurai Spirits - Zankurou Musouken (NGH-087) (modern set)" )
GAME( 1995, fswords, samsho3m, neogeo, neogeo, neogeo, ROT0_16BIT, "SNK", "Fighters Swords (Korean release of Samurai Shodown III) (modern set)" )
GAME( 1995, rbff1a, rbff1m, neogeo, neogeo, neogeo, ROT0_16BIT, "SNK", "Real Bout Fatal Fury / Real Bout Garou Densetsu (bug fix revision) (modern set)" )
GAME( 1995, rbff1ka, rbff1m, neogeo, neogeo, neogeo, ROT0_16BIT, "SNK", "Real Bout Fatal Fury / Real Bout Garou Densetsu (Korean release, bug fix revision) (modern set)" )
GAME( 1995, rbff1k, rbff1m, neogeo, neogeo, neogeo, ROT0_16BIT, "SNK", "Real Bout Fatal Fury / Real Bout Garou Densetsu (Korean release) (modern set)" )
GAME( 1996, aof3k, aof3m, neogeo, neogeo, neogeo, ROT0_16BIT, "SNK", "Art of Fighting 3 - The Path of the Warrior (Korean release) (modern set)" )
GAME( 1996, kof96a, kof96m, neogeo, neogeo, neogeo, ROT0_16BIT, "SNK", "The King of Fighters '96 (bug fix revision) (modern set)" )
GAME( 1996, kof96h, kof96m, neogeo, neogeo, neogeo, ROT0_16BIT, "SNK", "The King of Fighters '96 (NGH-214) (modern set)" )
GAME( 1996, ironclado, ironclad, neogeo, neogeo, neogeo, ROT0, "bootleg", "Choutetsu Brikin'ger / Iron Clad (prototype, bootleg) (modern set)" )
GAME( 1996, samsho4k, samsho4m, neogeo, neogeo, neogeo, ROT0_16BIT, "SNK", "Paewang Jeonseol / Legend of a Warrior (Korean censored Samurai Shodown IV) (modern set)" )
GAME( 1996, rbffspeck, rbffspecm, neogeo, neogeo, neogeo, ROT0_16BIT, "SNK", "Real Bout Fatal Fury Special / Real Bout Garou Densetsu Special (Korean release) (modern set)" )
GAME( 1997, kof97h, kof97m, neogeo, neogeo, neogeo, ROT0_16BIT, "SNK", "The King of Fighters '97 (NGH-2320) (modern set)" )
GAME( 1997, kof97k, kof97m, neogeo, neogeo, neogeo, ROT0_16BIT, "SNK", "The King of Fighters '97 (Korean release) (modern set)" )
GAME( 1997, lastbladh, lastbladm, neogeo, neogeo, neogeo, ROT0_16BIT, "SNK", "The Last Blade / Bakumatsu Roman - Gekka no Kenshi (NGH-2340) (modern set)" )
GAME( 1997, lastsold, lastbladm, neogeo, neogeo, neogeo, ROT0_16BIT, "SNK", "The Last Soldier (Korean release of The Last Blade) (modern set)" )
GAME( 1997, shocktroa, shocktrom, neogeo, neogeo, neogeo, ROT0_16BIT, "Saurus", "Shock Troopers (set 2) (modern set)" )
GAME( 1998, rbff2h, rbff2m, neogeo, neogeo, neogeo, ROT0_16BIT, "SNK", "Real Bout Fatal Fury 2 - The Newcomers / Real Bout Garou Densetsu 2 - The Newcomers (NGH-2400) (modern set)" )
GAME( 1998, rbff2k, rbff2m, neogeo, neogeo, neogeo, ROT0_16BIT, "SNK", "Real Bout Fatal Fury 2 - The Newcomers (Korean release) (modern set)" )
GAME( 2015, mslug2t, mslug2m, neogeo, neogeo, neogeo, ROT0_16BIT, "hack (trap15)", "Metal Slug 2 Turbo (NGM-9410) (hack) (modern set)" )
GAME( 2001, vliner7e, vliner, neogeo, neogeo, neogeo, ROT0, "Dyna / BrezzaSoft", "V-Liner (v0.7e) (modern set)" )
GAME( 2001, vliner6e, vliner, neogeo, neogeo, neogeo, ROT0, "Dyna / BrezzaSoft", "V-Liner (v0.6e) (modern set)" )
GAME( 2001, vliner54, vliner, neogeo, neogeo, neogeo, ROT0, "Dyna / BrezzaSoft", "V-Liner (v0.54) (modern set)" )
GAME( 2001, vliner53, vliner, neogeo, neogeo, neogeo, ROT0, "Dyna / BrezzaSoft", "V-Liner (v0.53) (modern set)" )
GAME( 1997, kof97pls, kof97m, neogeo, neogeo, neogeo, ROT0_16BIT, "bootleg", "The King of Fighters '97 Plus (bootleg) (modern set)" )
